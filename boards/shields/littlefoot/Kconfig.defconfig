## boards/shields/littlefoot/Kconfig.defconfig
```kconfig
# Copyright (c) 2026 The ZMK Contributors
# SPDX-License-Identifier: MIT

if SHIELD_LITTLEFOOT

config ZMK_KEYBOARD_NAME
    default "LittleFoot"

endif
```
